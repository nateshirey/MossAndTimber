// NeoPixel Ring simple sketch (c) 2013 Shae Erisson
// Released under the GPLv3 license to match the rest of the
// Adafruit NeoPixel library

#include <Adafruit_NeoPixel.h>
#ifdef __AVR__
 #include <avr/power.h> // Required for 16 MHz Adafruit Trinket
#endif

#include <Wire.h>

int serialInput = 0;

// Which pin on the Arduino is connected to the NeoPixels?
#define PIN        6 
#define buttonPin  2

bool canToggle = false;

//paste colors here
uint8_t flowReds [] = {3,3,4,4,5,6,6,7,9,11,14,21,29,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1,1};
uint8_t flowGreens [] = {0,0,0,0,0,0,0,0,0,0,0,0,0,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0,0};
uint8_t flowBlues [] = {0,0,0,0,0,0,0,0,0,0,0,0,0,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0,0};

//end paste block

//the following arrays are stages of a firework animation
uint8_t fireWorkAnimRed[] = {255, 223, 191, 159, 127, 95, 63, 31};
uint8_t fireWorkAnimGreen[] = {255, 150, 0, 0, 0, 0, 0, 0};
uint8_t fireWorkAnimBlue[] = {255, 150, 20, 20, 0, 0, 0, 0};

uint8_t lightningAnimRed[] = {255, 0, 255, 0, 0, 0, 50, 0, 0};
uint8_t lightningAnimGreen[] = {255, 0, 255, 0, 100, 0, 50, 0, 0};
uint8_t lightningAnimBlue[] = {255, 0, 255, 0, 100, 0, 50, 0, 0};

//long strands have 134 pixels, short strands have 127
#define lightsNum 1043

//long strands have 134 pixels, short strands have 127
#define Strand1 134
#define Strand2 260
#define Strand3 394
#define Strand4 521
#define Strand5 655
#define Strand6 782
#define Strand7 916
#define Strand8 1043

// When setting up the NeoPixel library, we tell it how many pixels,
// and which pin to use to send signals.
Adafruit_NeoPixel pixels(lightsNum, PIN, NEO_GRB + NEO_KHZ800);

long Time = 0;
long Speed = 2;
int currentState = 3;
int oldState = 0;

const int defaultState = 0;

const int lightningState = 1;
bool lightningRunning;
float lightningTimer = 255;
float lightningSpeed = 30;

const int dripState = 2;
const int twilightState = 3;

uint32_t colorBlack = pixels.Color(0, 0, 0);
uint32_t colorWhite = pixels.Color(128, 128, 128);

uint32_t colorLightning = pixels.Color(200, 200, 255);

void setup() {

  pixels.begin(); // INITIALIZE NeoPixel strip object (REQUIRED)
  pixels.setBrightness(255);
  pixels.show();
  Wire.begin(0x04);
  Wire.onReceive(receiveData);
  Wire.onRequest(sendData);
  pinMode(buttonPin, INPUT_PULLUP);
  pinMode(13, OUTPUT);
  Serial.begin(9600);
  lightningRunning = false;
}

void DefaultAction(){
    for(int i=0; i<lightsNum; i++){
      pixels.setPixelColor(i, colorBlack);
    }
}

void TwilightAction(){
    uint32_t Color8 = pixels.Color(245, 99, 0);
    uint32_t Color7 = pixels.Color(245, 99, 0);
    uint32_t Color6 = pixels.Color(245, 99, 0);
    uint32_t Color5 = pixels.Color(0, 0, 255);
    uint32_t Color4 = pixels.Color(0, 0, 255);
    uint32_t Color3 = pixels.Color(0, 0, 255);
    uint32_t Color2 = pixels.Color(0, 0, 255);
    uint32_t Color1 = pixels.Color(0, 0, 255);

    for(int i=0; i<lightsNum; i++){
      
          if (i < Strand1) {
            pixels.setPixelColor(i, Color8);
          }
          if (i > Strand1 && i < Strand2) {
            pixels.setPixelColor(i, Color7);
          }
          if (i > Strand2 && i < Strand3) {
            pixels.setPixelColor(i, Color6);
          }
          if (i > Strand3 && i < Strand4) {
            pixels.setPixelColor(i, Color5);
          }
          if (i > Strand4 && i < Strand5) {
            pixels.setPixelColor(i, Color4);
          }
          if (i > Strand5 && i < Strand6) {
            pixels.setPixelColor(i, Color3);
          }
          if (i > Strand6 && i < Strand7) {
            pixels.setPixelColor(i, Color2);
          }
          if (i > Strand7 && i < Strand8) {
            pixels.setPixelColor(i, Color1);
          }
    }
    pixels.show();
}

void DripAction(){
      for(int i=0; i<lightsNum; i++) { // For each pixel...
      uint8_t mask = flowReds[i] + Time; //this line creates motion
      if(mask > 255){
        mask = mask - 255;
      }
      mask = mask + flowGreens[i] * 100;
  
      uint32_t color = pixels.Color(255, 0, 0);
      pixels.setPixelColor(i, color);
      
      if(mask > 64){
          uint32_t color = pixels.Color(0, 234, 255);
          pixels.setPixelColor(i, color);
      }
      if(mask > 90){
          uint32_t color = pixels.Color(255, 210, 0);
          pixels.setPixelColor(i, color);
      }
      if(mask > 200){
          uint32_t color = pixels.Color(255, 0, 0);
          pixels.setPixelColor(i, color);
      }
    }
}

void LightningAction(){
  if(lightningRunning){
    lightningTimer -= lightningSpeed;
    int frame = int((lightningTimer / 255) * 8);
    Serial.println(frame);
    uint32_t color = pixels.Color(lightningAnimRed[frame], 
                                  lightningAnimRed[frame], 
                                  lightningAnimRed[frame]);
                                
    for(int i=0; i<lightsNum; i++){
      pixels.setPixelColor(i, color);
    }
  }

  if(lightningTimer < 0){
    //SetState(defaultState);
    uint32_t offColor = pixels.Color(0, 0, 0);
    for(int i=0; i<lightsNum; i++){
      pixels.setPixelColor(i, offColor);
    }
    lightningRunning = false;
  }
}

void SetState(int state){
  oldState = currentState;
  currentState = state;
  if(currentState == lightningState){
    ResetLightning(); 
  }
}

void ResetLightning(){
   lightningRunning = true;
   lightningTimer = 255;
}

void HandleState(){
  switch (currentState){
    case lightningState:
      LightningAction();
      break;
    case dripState:
      DripAction();
      break;
    case twilightState:
      TwilightAction();
      break;
    default:
      DefaultAction();
      break;
  }
}

void receiveData(int byteCount){
  while(Wire.available()){
    serialInput = Wire.read();
    Serial.print("Received: ");
    Serial.println(serialInput);

    if(serialInput == 1){
      ResetLightning();
    }
  }
  int x = Wire.read();
  Serial.println(x);
}

void sendData(){
  Wire.write(serialInput);
}

bool HandleButton(int sensorValue){
  if(canToggle && sensorValue == 0){
    return true;
  }
  else{
    return false;
  }
}

void loop() {
  int sensorVal = digitalRead(buttonPin);
  if(HandleButton(sensorVal)){
    if(currentState + 1 > 3){
      currentState = 0;
    }
    SetState(currentState + 1);
  }

  if(sensorVal == 1){
    canToggle = true;
  }
  else{
    canToggle = false;
  }
  
  delay(100);
  Time = Time + Speed;
  //count up by the speed and if the timer hits 255
  if(Time > 255) {
    Time = 0;
  }

  HandleState();
  
  pixels.show();   // Send the updated pixel colors to the hardware.
}
