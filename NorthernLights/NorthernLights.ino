// NeoPixel Ring simple sketch (c) 2013 Shae Erisson
// Released under the GPLv3 license to match the rest of the
// Adafruit NeoPixel library

#include <Adafruit_NeoPixel.h>
#ifdef __AVR__
 #include <avr/power.h> // Required for 16 MHz Adafruit Trinket
#endif

// Which pin on the Arduino is connected to the NeoPixels?
#define PIN        6 
#define buttonPin  2

//paste colors here
uint8_t reds [] = {14,15,17,19,21,23,25,27,29,30,32,34,36,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6,5};
uint8_t greens [] = {0,0,0,0,0,0,0,0,0,0,0,0,0,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0,0};
uint8_t blues [] = {0,0,0,0,0,0,0,255,255,255,0,0,0,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0,107};

//end paste block

//long strands have 134 pixels, short strands have 127
#define lightsNum 1043

// When setting up the NeoPixel library, we tell it how many pixels,
// and which pin to use to send signals.
Adafruit_NeoPixel pixels(lightsNum, PIN, NEO_GRB + NEO_KHZ800);

long timer = 0;
long luminance = 0;
long animSpeed = 2;
bool canToggle = false;

int currentState = 0;

//set max state to the state int that is greatest to loop back to default
const int maxState = 1;
const int defaultState = 0;
const int northernLightsState = 1;

uint32_t defaultColor = pixels.Color(255, 0, 0);

void setup() {
  pixels.begin(); // INITIALIZE NeoPixel strip object (REQUIRED)
  pixels.show();
  pinMode(buttonPin, INPUT_PULLUP);

}

bool HandleButton(int sensorValue){
  
  if(canToggle && sensorValue == 0){
    return true;
  }
  else{
    return false;
  }
}

void Count(){
  
  timer += animSpeed;
  if(timer > 255){
    timer = 0;
  }
}

//this is used for actually changing state
void SetState(int state){
  currentState = state;
}

//this is called every update to pick which 
//action to perform based on the current state
void HandleState(){
  switch(currentState){
    case northernLightsState:
      NorthernLightsAction();
      break;
    default:
      DefaultAction();
      break;
  }
}

void DefaultAction(){
  for(int i=0; i<lightsNum; i++){
    pixels.setPixelColor(i, defaultColor);
  }
}

void NorthernLightsAction(){
  
  luminance += animSpeed * 0.5;
  if(luminance > 255){
    luminance = 0;
  }
  
  for(int i=0; i<lightsNum; i++) { // For each pixel...
    uint8_t greenBrightness = reds[i] + timer;
    if(greenBrightness > 255){
      greenBrightness = greenBrightness - 255;
    }
    if(greenBrightness < 235){
      greenBrightness = 0;
    }
    greenBrightness *= greens[i];

    uint8_t blueBrightness = reds[i] + (timer * 1.3);
    if(blueBrightness > 255){
      blueBrightness = blueBrightness - 255;
    }
    if(blueBrightness < 235){
      blueBrightness = 0;
    }
    blueBrightness *= blues[i];

    if(blueBrightness > 30 || greenBrightness > 30){
      uint32_t color = pixels.Color(0, greenBrightness, blueBrightness * luminance);
      pixels.setPixelColor(i, color);
    }
    else{
      uint32_t color = pixels.Color(20, 0, 40);
      pixels.setPixelColor(i, color);
    }
  }
}

void loop() {

  Count();
  int buttonVal = digitalRead(buttonPin);
  
  if(HandleButton(buttonVal)){
    
    if(currentState + 1 > maxState){
      currentState = 0;
      SetState(currentState);
    }
    else{
      SetState(currentState + 1);
    }
  }
  
  if(buttonVal == 1){
    canToggle = true;
  }
  else{
    canToggle = false;
  }

  HandleState();
  pixels.show();   // Send the updated pixel colors to the hardware.
}
