// NeoPixel Ring simple sketch (c) 2013 Shae Erisson
// Released under the GPLv3 license to match the rest of the
// Adafruit NeoPixel library

#include <Adafruit_NeoPixel.h>
#ifdef __AVR__
 #include <avr/power.h> // Required for 16 MHz Adafruit Trinket
#endif

// Which pin on the Arduino is connected to the NeoPixels?
#define PIN        6 

//paste colors here
uint8_t xCoord [] = {245,244,242,240,238,236,234,232,230,228,226,225,223,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251,253};
uint8_t yCoord [] = {0,0,0,0,0,0,0,0,0,0,0,0,0,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223,223};

//end paste block

//long strands have 134 pixels, short strands have 127
#define lightsNum 1043

// When setting up the NeoPixel library, we tell it how many pixels,
// and which pin to use to send signals.
Adafruit_NeoPixel pixels(lightsNum, PIN, NEO_GRB + NEO_KHZ800);

long startTime = 0;
long moveSpeed = 10;
int state = 1;
long timer = 0;

long valueX = 0;
long valueY = 0;

void setup() {
  startTime = millis();

  pixels.begin(); // INITIALIZE NeoPixel strip object (REQUIRED)
  pixels.show();
}

void Wipe() {
  for(int i=0; i<lightsNum; i++) { // For each pixel...
    uint32_t color = pixels.Color(0, 0, 255);

    long pos = xCoord[i] - 127;
    pos = abs(pos);
    pos = pos - 127;
    pos = abs(pos);
    if(pos >= timer){
      color = pixels.Color(0, 255, 0);
    }
    pixels.setPixelColor(i, color);
  }
}

void Hit(){
  uint8_t center = 127;
  uint8_t radius = 127;
  for(int i=0; i<lightsNum; i++){
    uint32_t color = pixels.Color(0, 0, 0);

    long x = xCoord[i] - center;
    long y = yCoord[i] - center;
    //this just accounts for the stretch
    x = x * 2;

    valueX = x * x + y * y;
    valueX = sqrt(valueX);

    if(valueX < radius){
      color = pixels.Color(255, 0, 0);
    }

    pixels.setPixelColor(i, color);
  }
}

void Pulse(){
  uint8_t luminence = sin(timer * 0.25);
  uint8_t center = 127;
  uint8_t radius = timer;
  
  for(int i=0; i<lightsNum; i++){
    uint32_t color = pixels.Color(0, 0, 0);

    long x = xCoord[i] - center;
    long y = yCoord[i] - center;
    //this just accounts for the stretch
    x = x * 2;
    //distance from center
    valueX = x * x + y * y;
    valueX = sqrt(valueX);

    if(valueX < radius){
      color = pixels.Color(255, 0, 0);
    }
    
    pixels.setPixelColor(i, color);
  }
}

void HandleState(){
  switch(state){
    case 0:
      Wipe();
      break;
    case 1:
      Hit();
      break;
    case 2:
      Pulse();
      break;
  }
}

void loop() {
  timer += moveSpeed;

  if(timer > 255){
    timer = 0;
    
    state += 1;
    if(state > 2){
      state = 0;
    }
  }
  
  HandleState();
  
  pixels.show();   // Send the updated pixel colors to the hardware.

}
