// NeoPixel Ring simple sketch (c) 2013 Shae Erisson
// Released under the GPLv3 license to match the rest of the
// Adafruit NeoPixel library

#include <Adafruit_NeoPixel.h>
#ifdef __AVR__
 #include <avr/power.h> // Required for 16 MHz Adafruit Trinket
#endif

// Which pin on the Arduino is connected to the NeoPixels?
#define PIN        6 

//paste colors here
uint8_t flowReds [] = {3,3,4,4,5,6,6,7,9,11,14,21,29,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1,1};
uint8_t flowGreens [] = {0,0,0,0,0,0,0,0,0,0,0,0,0,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0,0};
uint8_t flowBlues [] = {0,0,0,0,0,0,0,0,0,0,0,0,0,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0,0};

//end paste block

//long strands have 134 pixels, short strands have 127
#define lightsNum 1043

// When setting up the NeoPixel library, we tell it how many pixels,
// and which pin to use to send signals.
Adafruit_NeoPixel pixels(lightsNum, PIN, NEO_GRB + NEO_KHZ800);

long Time = 0;
long Speed = 1;

void setup() {

  pixels.begin(); // INITIALIZE NeoPixel strip object (REQUIRED)
  pixels.show();
}

void loop() {
  Time = Time + Speed;

  if(Time > 255) {
    Time = 0;
    }
    
  for(int i=0; i<lightsNum; i++) { // For each pixel...
    uint8_t mask = flowReds[i] + Time; //this line creates motion
    if(mask > 255){
      mask = mask - 255;
      }
    mask = mask + flowGreens[i] * 100;

    uint32_t color = pixels.Color(255, 0, 0);
    pixels.setPixelColor(i, color);
    
    if(mask > 64){
        uint32_t color = pixels.Color(0, 234, 255);
        pixels.setPixelColor(i, color);
      }
    if(mask > 90){
        uint32_t color = pixels.Color(255, 210, 0);
        pixels.setPixelColor(i, color);
      }
    if(mask > 200){
        uint32_t color = pixels.Color(255, 0, 0);
        pixels.setPixelColor(i, color);
    }
    
    }
    
  pixels.show();   // Send the updated pixel colors to the hardware.
}
